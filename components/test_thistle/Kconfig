## components/test_thistle/Kconfig
```kconfig
menu "ThistleOS Tests"
    config THISTLE_RUN_TESTS
        bool "Run ThistleOS unit tests on boot"
        default n
        help
            When enabled, the firmware runs the ThistleOS test suite
            instead of the normal boot sequence.
endmenu
```

## recovery/sdkconfig.defaults
```kconfig
# ThistleOS Recovery — Minimal config
CONFIG_IDF_TARGET="esp32s3"
CONFIG_ESPTOOLPY_FLASHSIZE_16MB=y
CONFIG_ESPTOOLPY_FLASHMODE_QIO=y
CONFIG_COMPILER_OPTIMIZATION_SIZE=y
CONFIG_BT_ENABLED=n
CONFIG_SPIRAM=n
CONFIG_ESP_WIFI_STATIC_RX_BUFFER_NUM=4
CONFIG_ESP_WIFI_DYNAMIC_RX_BUFFER_NUM=8
CONFIG_ESP_MAIN_TASK_STACK_SIZE=8192
CONFIG_ESP_HTTP_CLIENT_ENABLE_HTTPS=y
CONFIG_ESP_TASK_WDT_TIMEOUT_S=30

# Recovery is size-constrained; keep diagnostics and protocol surface minimal.
# CONFIG_ESP_GDBSTUB_ENABLED is not set
CONFIG_COMPILER_OPTIMIZATION_ASSERTIONS_DISABLE=y
CONFIG_HAL_ASSERTION_DISABLE=y
CONFIG_LOG_DEFAULT_LEVEL_WARN=y
CONFIG_LOG_MAXIMUM_EQUALS_DEFAULT=y
# CONFIG_LOG_DYNAMIC_LEVEL_CONTROL is not set
CONFIG_LOG_TAG_LEVEL_IMPL_NONE=y
# CONFIG_LOG_IN_IRAM is not set

# Recovery serves an IPv4-only captive portal and only needs WPA2 station mode.
# CONFIG_LWIP_IPV6 is not set
# CONFIG_ESP_WIFI_ENABLE_WPA3_SAE is not set
# CONFIG_ESP_WIFI_ENABLE_SAE_PK is not set
# CONFIG_ESP_WIFI_ENABLE_SAE_H2E is not set
# CONFIG_ESP_WIFI_SOFTAP_SAE_SUPPORT is not set
# CONFIG_ESP_WIFI_ENABLE_WPA3_OWE_STA is not set
# CONFIG_ESP_WIFI_ENTERPRISE_SUPPORT is not set

# HTTPS bundle downloads need a TLS client, not a TLS server.
CONFIG_MBEDTLS_CERTIFICATE_BUNDLE_DEFAULT_CMN=y
CONFIG_MBEDTLS_TLS_CLIENT_ONLY=y
# CONFIG_MBEDTLS_TLS_SERVER is not set
# CONFIG_MBEDTLS_PEM_WRITE_C is not set
# CONFIG_MBEDTLS_X509_CRL_PARSE_C is not set
# CONFIG_MBEDTLS_X509_CSR_PARSE_C is not set
# CONFIG_MBEDTLS_ERROR_STRINGS is not set
```

## components/elf_loader/Kconfig
```kconfig
menu "Espressif ELF Loader Configuration"
    visible if (IDF_TARGET_ESP32 || IDF_TARGET_ESP32S2 || IDF_TARGET_ESP32S3 || IDF_TARGET_ESP32C3 || IDF_TARGET_ESP32C6)

    config ELF_LOADER_BUS_ADDRESS_MIRROR
        bool
        default y if (IDF_TARGET_ESP32 || IDF_TARGET_ESP32S2 || IDF_TARGET_ESP32S3)
        default n if (IDF_TARGET_ESP32C3 || IDF_TARGET_ESP32C6)

    config ELF_LOADER
        bool "Enable Espressif ELF Loader"
        default y

    if ELF_LOADER
        config ELF_LOADER_LOAD_PSRAM
            bool "Load ELF to PSRAM"
            default y
            depends on (IDF_TARGET_ESP32S2 || IDF_TARGET_ESP32S3) && SPIRAM
            select ELF_LOADER_CACHE_OFFSET
            select ELF_LOADER_SET_MMU if IDF_TARGET_ESP32S2

        config ELF_LOADER_CACHE_OFFSET
            bool
            default n

        config ELF_LOADER_SET_MMU
            bool
            default n

        config ELF_LOADER_LIBC_SYMBOLS
            bool "Libc Symbols Table"
            default y

        config ELF_LOADER_ESPIDF_SYMBOLS
            bool "ESP-IDF Symbols Table"
            default y

        config ELF_LOADER_CUSTOMER_SYMBOLS
            bool "Customer Symbols Table"
            default n

        config ELF_LOADER_NUMBER_SYMBOLS
            int "Maximum number of registered symbol tables"
            range 1 4096
            default 32
    endif
endmenu
```

## sdkconfig.defaults.esp32c6
```kconfig
# ESP32-C6 target defaults
CONFIG_ESP_DEFAULT_CPU_FREQ_MHZ_160=y
CONFIG_BT_ENABLED=y
CONFIG_BT_NIMBLE_ENABLED=y
CONFIG_BT_NIMBLE_ROLE_PERIPHERAL=y
CONFIG_BT_NIMBLE_ROLE_CENTRAL=n
CONFIG_BT_NIMBLE_ROLE_OBSERVER=n
CONFIG_BT_NIMBLE_ROLE_BROADCASTER=y
CONFIG_BT_NIMBLE_SECURITY_ENABLE=y
CONFIG_BT_NIMBLE_SM_LEGACY=n
CONFIG_BT_NIMBLE_SM_SC=y
CONFIG_BT_NIMBLE_SM_SC_ONLY=1
CONFIG_BT_NIMBLE_SM_LVL=4
```

## sdkconfig.defaults.esp32s3
```kconfig
# ESP32-S3 target defaults
CONFIG_ESP_DEFAULT_CPU_FREQ_MHZ_240=y

# S3 boards use external PSRAM. QUAD mode is the known-good ESP-IDF v5.5 mode.
CONFIG_SPIRAM=y
CONFIG_SPIRAM_MODE_QUAD=y
CONFIG_SPIRAM_SPEED_80M=y
CONFIG_SPIRAM_BOOT_HW_INIT=y
CONFIG_SPIRAM_BOOT_INIT=y
CONFIG_SPIRAM_USE_MALLOC=y
CONFIG_SPIRAM_MALLOC_ALWAYSINTERNAL=4096
CONFIG_SPIRAM_ALLOW_BSS_SEG_EXTERNAL_MEMORY=y
CONFIG_FREERTOS_TASK_CREATE_ALLOW_EXT_MEM=y

CONFIG_BT_ENABLED=y
CONFIG_BT_NIMBLE_ENABLED=y
CONFIG_BT_NIMBLE_ROLE_PERIPHERAL=y
CONFIG_BT_NIMBLE_ROLE_CENTRAL=n
CONFIG_BT_NIMBLE_ROLE_OBSERVER=n
CONFIG_BT_NIMBLE_ROLE_BROADCASTER=y
CONFIG_BT_NIMBLE_SECURITY_ENABLE=y
CONFIG_BT_NIMBLE_SM_LEGACY=n
CONFIG_BT_NIMBLE_SM_SC=y
CONFIG_BT_NIMBLE_SM_SC_ONLY=1
CONFIG_BT_NIMBLE_SM_LVL=4
```
